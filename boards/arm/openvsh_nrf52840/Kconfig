## boards/arm/openvsh_nrf52840/Kconfig.board
```kconfig
config BOARD_OPENVSH_NRF52840
	bool "OpenVSH NRF52840"
	depends on SOC_NRF52840_QIAA
```

## boards/arm/openvsh_nrf52840/Kconfig.defconfig
```kconfig
if BOARD_OPENVSH_NRF52840

config BOARD
	default "openvsh_nrf52840"

config BT_CTLR
	default BT

endif # BOARD_OPENVSH_NRF52840
```

## boards/openvsh/openvsh_board0/Kconfig.defconfig
```kconfig
if BOARD_OPENVSH_BOARD0

config BT_CTLR
	default BT

endif # BOARD_OPENVSH_BOARD0
```
